/dts-v1/;
/plugin/;

#include "quin-vm-display-la.dtsi"

/ {
	model = "Qualcomm Technologies, Inc. SA7255 Single LA Virtual Machine";
	compatible = "qcom,monaco", "qcom,quinvm";
	qcom,msm-id = <606 0x10000>;
	qcom,board-id = <0 0x1000001>;
};
