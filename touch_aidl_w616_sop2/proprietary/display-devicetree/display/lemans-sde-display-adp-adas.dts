/dts-v1/;
/plugin/;

#include "lemans-sde-display-adp-star.dtsi"
#include "lemans-sde-display-adp-adas.dtsi"

/ {
    model = "Qualcomm Technologies, Inc. Lemans IVI ADP AIR";
    compatible = "qcom,lemans-ivi-adas";
    qcom,msm-id = <533 0x10000>;
    qcom,board-id = <0 0>;
};
