/dts-v1/;
/plugin/;

#include "sa8195p-adp-star-display.dtsi"
#include "sa8195p-adp-star-display-lxc-shd.dtsi"

/ {
	model = "Qualcomm Technologies, Inc. SA8195P SoC";
	qcom,msm-name = "SA8195P";
	qcom,msm-id = <405 0x20000>;
	qcom,board-id = <0 0>;
};
