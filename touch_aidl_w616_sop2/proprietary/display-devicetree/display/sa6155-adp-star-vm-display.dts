/dts-v1/;
/plugin/;

#include "quin-vm-display-la.dtsi"

/ {
	model = "Qualcomm Technologies, Inc. SA6155P Guest Virtual Machine";
	compatible = "qcom,sa6155p", "qcom,quinvm";
	qcom,board-id = <0 0x1000001>;
	qcom,msm-id = <377 0x10000>;
};
