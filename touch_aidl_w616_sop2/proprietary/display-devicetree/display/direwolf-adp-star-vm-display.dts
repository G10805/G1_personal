/dts-v1/;
/plugin/;

#include "quin-vm-display-la.dtsi"

/ {
        model = "Qualcomm Technologies, Inc. Direwolf Single LA Virtual Machine";
        compatible = "qcom,direwolf", "qcom,quinvm";
        qcom,msm-id = <460 0x10000>;
        qcom,board-id = <0 0x1000001>, <0 0x2000001>;
};

