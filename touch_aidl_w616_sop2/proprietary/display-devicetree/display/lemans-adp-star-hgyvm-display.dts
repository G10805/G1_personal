/dts-v1/;
/plugin/;

#include "quin-hgyvm-display-la.dtsi"

/ {
	model = "Qualcomm Technologies, Inc. SA8155 Single LA Guest Virtual Machine";
	compatible = "qcom,lemans", "qcom,qam";
	qcom,board-id = <0x10019 0x0>, <0x10025 0x0>;
	qcom,msm-id = <532 0x10000>, <533 0x10000>, <534 0x10000>, <619 0x10000>, <532 0x20000>, <533 0x20000>, <534 0x20000>, <619 0x20000>;
};
