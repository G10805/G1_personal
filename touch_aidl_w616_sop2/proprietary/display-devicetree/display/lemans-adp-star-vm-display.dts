/dts-v1/;
/plugin/;

#include "quin-vm-display-la.dtsi"

/ {
	model = "Qualcomm Technologies, Inc. SA8155 Single LA Guest Virtual Machine";
	compatible = "qcom,lemans", "qcom,quinvm";
	qcom,board-id = <0 0x1000001>, <0 0x2000001>;
	qcom,msm-id = <532 0x20000>;
};
