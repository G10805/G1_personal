/dts-v1/;
/plugin/;

#include "lemans-sde-display-adp-star.dtsi"
#include "lemans-adp-star-display-shd.dtsi"
/ {
    model = "Qualcomm Technologies, Inc. Lemans IVI ADP AIR";
    compatible = "qcom,lemans", "qcom,adp-air", "qcom,lemans-ivi", "qcom,lemans-ivi-adp-air",  "qcom,qam-star";
    qcom,msm-id = <532 0x10000>, <534 0x10000>;
    qcom,board-id = <0 0>;
};
