/dts-v1/;
/plugin/;

#include "quin-vm-display-lv.dtsi"

/ {
    model = "Qualcomm Technologies, Inc. LV Virtual Machine";
    compatible = "qcom,lemans", "qcom,direwolf", "qcom,quinvm", "qcom,monaco";
    qcom,board-id = <0x0 0x1000002>, <0x0 0x2000002>;
};
