/dts-v1/;
/plugin/;

#include "quin-hgyvm-display-la.dtsi"

/ {
	model = "Qualcomm Technologies, Inc. SA7255 Single LA Guest Virtual Machine";
	compatible = "qcom,monaco", "qcom,qam";
	qcom,board-id = <0x10019 0x0>;
	qcom,msm-id = <606 0x10000>;
};
