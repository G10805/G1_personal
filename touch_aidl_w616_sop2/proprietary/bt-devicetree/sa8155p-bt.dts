/dts-v1/;
/plugin/;

#include "sa8155p-bt.dtsi"

/ {
	model = "Qualcomm Technologies, Inc. SA8155P SoCs";
	compatible = "qcom,sa8155p";
	qcom,msm-id = <339 0x10000>, <362 0x10000>, <362 0x20000>, <367 0x20000>, <367 0x10000>;
	qcom,board-id = <0X01000019 0>, <25 0>, <0x0 0x1000001>, <0x0 0x2000001>;
};
