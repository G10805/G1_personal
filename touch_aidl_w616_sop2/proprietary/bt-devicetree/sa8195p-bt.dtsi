#include <dt-bindings/interconnect/qcom,sm8150.h>

&soc {
	bluetooth: bt-qca-auto-converged {
		compatible = "qcom,qca-auto-converged";
		pinctrl-names = "default";
		pinctrl-0 = <&bt_en_active>;
		/* BT_EN */
		qcom,bt-reset-gpio = <&tlmm 172 0>;
		/* WL_EN */
		qcom,wl-reset-gpio = <&tlmm 169 0>;
		/* PWR_CTR1_VDD_PA */
		qcom,bt-vdd-ctrl1-supply = <&vreg_conn_pa>;
		/* PWR_CTR2_VDD_1P8 */
		qcom,bt-vdd-ctrl2-supply = <&vreg_conn_1p8>;
		qcom,bt-vdd-aon-supply = <&pm8195_1_s5>;
		qcom,bt-vdd-rfa1-supply = <&pm8195_1_s2>;
		qcom,bt-vdd-rfa2-supply = <&pm8195_2_s5>;
		qcom,bt-vdd-rfa3-supply = <&pm8195_2_l7>;

		/* <vol_min, vol_max, load_curr, is_retention_supp> */
		qcom,bt-vdd-ctrl1-config = <0 0 0 0>;
		qcom,bt-vdd-ctrl2-config = <0 0 0 0>;
		qcom,bt-vdd-aon-config = <1000000 1000000 0 0>;
		qcom,bt-vdd-rfa1-config = <1370000 1370000 0 0>;
		qcom,bt-vdd-rfa2-config = <2040000 2040000 0 0>;
		qcom,bt-vdd-rfa3-config = <1900000 1900000 450000 0>;
	};
};

&qupv3_se17_4uart {
	status = "ok";
	qcom,auto-suspend-disable;
};

