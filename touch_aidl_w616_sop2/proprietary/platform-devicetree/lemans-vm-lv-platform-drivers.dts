/dts-v1/;
/plugin/;

#include "quin-vm-common-platform-drivers.dtsi"
#include "lemans-vm-lv-platform-drivers.dtsi"

/ {
	model = "Qualcomm Technologies, Inc. Lemans Single LV Guest Virtual Machine";
	compatible = "qcom,lemans", "qcom,quinvm";
	qcom,msm-id = <532 0x20000>;
	qcom,board-id = <0x0 0x1000002>, <0x0 0x2000002>;
};

