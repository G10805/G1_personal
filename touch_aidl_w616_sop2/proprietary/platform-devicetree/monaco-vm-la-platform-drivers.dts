/dts-v1/;
/plugin/;

#include "quin-vm-common-platform-drivers.dtsi"

/ {
	model = "Qualcomm Technologies, Inc. Monaco Single LA Virtual Machine";
	compatible = "qcom,monaco", "qcom,quinvm";
	qcom,msm-id = <606 0x10000>;
	qcom,board-id = <0 0x1000001>;
};
