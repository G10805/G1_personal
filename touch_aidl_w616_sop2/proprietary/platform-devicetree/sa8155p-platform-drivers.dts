/dts-v1/;
/plugin/;

#include "sa8155-platform-drivers.dtsi"

/ {
	model = "Qualcomm Technologies, Inc. SA8155 v2 SoC";
	compatible = "qcom,sa8155p-v2-adp-air", "qcom,sa8155p-adp-star", "qcom,sa8155", "qcom,sa8155p",
			"qcom,adp-air", "qcom,adp-star";
	qcom,msm-id = <362 0x20000>, <367 0x20000>;
	qcom,board-id = <0x01000019 0>, <25 0>;
};
