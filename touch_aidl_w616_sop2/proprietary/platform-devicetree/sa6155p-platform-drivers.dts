/dts-v1/;
/plugin/;

#include "sa6155p-platform-drivers.dtsi"

/ {
	model = "Qualcomm Technologies, Inc. SA6155P SoC";
	compatible = "qcom,sa6155p-adp-air", "qcom,sa6155p", "qcom,adp-air", "qcom,sa6155p-adp-star", "qcom,adp-star", "qcom,sa6155";
	qcom,msm-id = <377 0x0>, <380 0>, <384 0x0>;
	qcom,board-id = <0x03010019 0>, <0x010019 0>;
};
