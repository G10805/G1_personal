/dts-v1/;
/plugin/;

#include "quin-vm-common-platform-drivers.dtsi"

/ {
	model = "Qualcomm Technologies, Inc. SA8155 LA Guest Virtual Machine";
	compatible = "qcom,sa8155", "qcom,quinvm";
	qcom,msm-id = <362 0x20000>;
	qcom,board-id = <0x0 0x1000001>, <0x0 0x2000001>;
};

