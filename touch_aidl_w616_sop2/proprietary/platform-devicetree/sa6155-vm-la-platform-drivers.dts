/dts-v1/;
/plugin/;

#include "quin-vm-common-platform-drivers.dtsi"

/ {
	model = "Qualcomm Technologies, Inc. SA6155P Guest Virtual Machine";
	compatible = "qcom,sa6155p", "qcom,quinvm";
	qcom,msm-id = <377 0x10000>;
	qcom,board-id = <0x0 0x1000001>;
};
