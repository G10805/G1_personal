/dts-v1/;
/plugin/;

#include <dt-bindings/interrupt-controller/arm-gic.h>
#include <dt-bindings/clock/qcom,gcc-sm6150.h>
#include <dt-bindings/clock/qcom,videocc-sm6150.h>
#include <dt-bindings/interconnect/qcom,sm6150.h>
#include "sm6150-vidc.dtsi"

/ {
	model = "Qualcomm Technologies, Inc. SA6155P";
	qcom,msm-name = "SA6155P";
	compatible = "qcom,sa6155p";
	qcom,msm-id = <377 0>, <380 0>;
	qcom,board-id = <0 0>;
};
