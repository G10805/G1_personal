/dts-v1/;
/plugin/;

#include <dt-bindings/interrupt-controller/arm-gic.h>
#include <dt-bindings/clock/qcom,gcc-sm8150.h>
#include <dt-bindings/interconnect/qcom,sm8150.h>
#include <dt-bindings/clock/qcom,videocc-sm8150.h>
#include "sm8150-vidc.dtsi"

/ {
	model = "Qualcomm Technologies, Inc. SM8150";
	compatible = "qcom,sm8150";
	qcom,msm-id = <339 0x10000>, <362 0x10000>, <362 0x20000>, <367 0x20000>, <367 0x10000>;
	qcom,board-id = <0 0>;
};
