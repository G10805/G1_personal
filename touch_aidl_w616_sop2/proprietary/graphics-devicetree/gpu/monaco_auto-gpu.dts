/dts-v1/;
/plugin/;

#include <dt-bindings/clock/qcom,rpmh.h>
#include <dt-bindings/soc/qcom,ipcc.h>
#include <dt-bindings/clock/qcom,aop-qmp.h>
#include <dt-bindings/clock/qcom,gcc-monaco_auto.h>
#include <dt-bindings/clock/qcom,aop-qmp.h>
#include <dt-bindings/clock/qcom,gpucc-lemans.h>
#include <dt-bindings/interconnect/qcom,monaco_auto.h>
#include <dt-bindings/interrupt-controller/arm-gic.h>
#include <dt-bindings/regulator/qcom,rpmh-regulator-levels.h>

#include "monaco_auto-gpu.dtsi"

/ {
	model = "Qualcomm Technologies, Inc. Monaco AUTO";
	compatible = "qcom,monaco_auto";
	msm-id = <605 0x10000>, <606 0x10000>;
	qcom,board-id = <0 0>;
};

