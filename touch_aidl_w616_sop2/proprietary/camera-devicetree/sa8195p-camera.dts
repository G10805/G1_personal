/dts-v1/;
/plugin/;

#include <dt-bindings/clock/qcom,gcc-sc8180x.h>
#include <dt-bindings/clock/qcom,camcc-sc8180x.h>
#include <dt-bindings/interconnect/qcom,sc8180x.h>
#include <dt-bindings/interrupt-controller/arm-gic.h>
#include <dt-bindings/regulator/qcom,rpmh-regulator-levels.h>

#include "sa8195p-camera.dtsi"
#include "sa8195p-camera-sensor.dtsi"

/ {
        model = "Qualcomm Technologies, Inc. SA8195P";
        qcom,msm-name = "SA8195P";
        qcom,board-id = <0 0>;
        qcom,msm-id = <405 0x20000>;
};

