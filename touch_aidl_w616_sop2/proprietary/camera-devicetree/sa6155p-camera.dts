/dts-v1/;
/plugin/;

#include <dt-bindings/clock/qcom,gcc-sm6150.h>
#include <dt-bindings/clock/qcom,camcc-sm6150.h>
#include <dt-bindings/interconnect/qcom,sm6150.h>
#include <dt-bindings/interrupt-controller/arm-gic.h>
#include <dt-bindings/regulator/qcom,rpmh-regulator-levels.h>

#include "sm6150-camera.dtsi"
#include "sa6155p-camera.dtsi"

/ {
    model = "ADP-AIR";
    qcom,msm-name = "SA6155P";
    compatible = "qcom,sa6155p-adp-star","qcom,adp-star", "qcom,sa6155p-adp-air", "qcom,sa6155p", "qcom,adp-air";
    qcom,msm-id = <377 0>, <380 0>;
    qcom,board-id = <0x010019 0>, <0x3010019 0>;
};
